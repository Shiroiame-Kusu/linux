## Kconfig.rej
```kconfig
--- Kconfig
+++ Kconfig
@@ -168,11 +168,6 @@ config ACER_WIRELESS
           If you choose to compile this driver as a module the module will be
           called acer-wireless.
 
-config ACPI_CALL
-	tristate "acpi_call module"
-	help
-	  This embeds acpi_call module into the kernel
-
 config ACER_WMI
 	tristate "Acer WMI Laptop Extras"
 	depends on BACKLIGHT_CLASS_DEVICE
```

## kernel/Kconfig.preempt.rej
```kconfig
--- kernel/Kconfig.preempt
+++ kernel/Kconfig.preempt
@@ -169,6 +169,7 @@ config SCHED_CORE
 config SCHED_CLASS_EXT
 	bool "Extensible Scheduling Class"
 	depends on BPF_SYSCALL && BPF_JIT && DEBUG_INFO_BTF
+	select GENERIC_ALLOCATOR
 	select STACKTRACE if STACKTRACE_SUPPORT
 	help
 	  This option enables a new scheduler class sched_ext (SCX), which
```
